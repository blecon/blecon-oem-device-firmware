## CMakeLists.txt
```
# Copyright (c) Blecon Ltd
# SPDX-License-Identifier: Apache-2.0

cmake_minimum_required(VERSION 3.20.0)

# include top-level application defines
include(../../cmake/app.cmake)

find_package(Zephyr REQUIRED HINTS $ENV{ZEPHYR_BASE})

set(CMAKE_C_STANDARD 11)

project(minimal)
target_sources(app PRIVATE src/main.c)

zephyr_include_directories(config)
```

## sysbuild.conf
```
# Copyright (c) Blecon Ltd
# SPDX-License-Identifier: Apache-2.0

# Sysbuild configuration file.

# Enable MCUboot per default for this application.
SB_CONFIG_BOOTLOADER_MCUBOOT=y
SB_CONFIG_BOOT_SIGNATURE_KEY_FILE="\${APPLICATION_CONFIG_DIR}/../../../blecon-oem-device-firmware/keys/ota-key.pem"
```

## prj.conf
```kconfig
# Copyright (c) Blecon Ltd
# SPDX-License-Identifier: Apache-2.0

CONFIG_GPIO=y
CONFIG_LED=y
CONFIG_PWM=y
CONFIG_INPUT=y
CONFIG_INPUT_MODE_SYNCHRONOUS=y

# DFU Image Management
CONFIG_FLASH_JESD216_API=y
CONFIG_FLASH_MAP=y
CONFIG_STREAM_FLASH=y
CONFIG_IMG_MANAGER=y
CONFIG_IMG_ENABLE_IMAGE_CHECK=y
CONFIG_IMG_ERASE_PROGRESSIVELY=y

# Use PSA for flash integrity checks, not Mbed TLS
CONFIG_FLASH_AREA_CHECK_INTEGRITY_PSA=y
CONFIG_FLASH_AREA_CHECK_INTEGRITY_MBEDTLS=n

# Enable Blecon integration
CONFIG_BLECON=y

# Enable Memfault integration
CONFIG_MEMFAULT=y
CONFIG_MEMFAULT_METRICS_DEFAULT_SET_ENABLE=y
CONFIG_MEMFAULT_METRICS_CPU_TEMP=n
CONFIG_MEMFAULT_METRICS_CONNECTIVITY_CONNECTED_TIME=n
CONFIG_MEMFAULT_USER_CONFIG_SILENT_FAIL=n

CONFIG_BLECON_MEMFAULT=y
CONFIG_BLECON_MEMFAULT_SOFTWARE_TYPE="main"

# Enable OTA library
CONFIG_BLECON_LIB_OTA=y

# Disable Nordic-provided Memfault integration
CONFIG_MEMFAULT_NCS_PROJECT_KEY="XXX"
CONFIG_MEMFAULT_NCS_FW_TYPE="XXX"
CONFIG_MEMFAULT_NCS_DEVICE_ID="XXX"
CONFIG_MEMFAULT_NCS_FW_VERSION_PREFIX="dev2+"
CONFIG_MEMFAULT_NCS_PROVISION_CERTIFICATES=n
CONFIG_MEMFAULT_NCS_STACK_METRICS=n
CONFIG_MEMFAULT_DEVICE_INFO_CUSTOM=y

# Events
CONFIG_EVENTS=y

# Logging
CONFIG_PRINTK=y
CONFIG_LOG=y
CONFIG_LOG_PRINTK=y
CONFIG_LOG_BUFFER_SIZE=4096
CONFIG_SHELL_LOG_BACKEND=n
CONFIG_LOG_DEFAULT_LEVEL=3

# Optimize for size
CONFIG_SIZE_OPTIMIZATIONS=y
# CONFIG_DEBUG_OPTIMIZATIONS=y

# Heap
CONFIG_HEAP_MEM_POOL_SIZE=4096

# Main thread
CONFIG_MAIN_STACK_SIZE=16384

# System workqueue
CONFIG_SYSTEM_WORKQUEUE_STACK_SIZE=16384

# Asserts
CONFIG_ASSERT=y
CONFIG_ASSERT_VERBOSE=y

# Shell
CONFIG_SHELL=n
CONFIG_SHELL_BACKEND_SERIAL=n
```

## boards/k7p54l_nrf54l15_cpuapp.conf
```kconfig
# Copyright (c) Blecon Ltd
# SPDX-License-Identifier: Apache-2.0

CONFIG_MEMFAULT_RAM_BACKED_COREDUMP_SIZE=4096
CONFIG_LOG_BUFFER_SIZE=2048

# Select internal modem
CONFIG_BLECON_EXTERNAL_MODEM=n
CONFIG_BLECON_INTERNAL_MODEM=y
CONFIG_BLECON_INTERNAL_MODEM_NFC=n

# Internal modem platform
CONFIG_BLECON_PORT_CRYPTO=y
CONFIG_BLECON_PORT_NVM=y
CONFIG_BLECON_PORT_BLUETOOTH=y
CONFIG_BLECON_PORT_EVENT_LOOP=y
CONFIG_BLECON_PORT_NFC=n

# Bluetooth
CONFIG_BT=y
CONFIG_BT_OBSERVER=y
CONFIG_BT_BROADCASTER=y
CONFIG_BT_PERIPHERAL=y
CONFIG_BT_USER_PHY_UPDATE=y

# At the moment, the following options are required to get L2CAP dynamic channels enabled
CONFIG_BT_SMP=y
# CONFIG_BT_CONN_DISABLE_SECURITY=y
CONFIG_BT_PRIVACY=n

CONFIG_BT_EXT_ADV=y
CONFIG_BT_L2CAP_DYNAMIC_CHANNEL=y
CONFIG_BT_L2CAP_SEG_RECV=y
CONFIG_BT_EXT_ADV_MAX_ADV_SET=3
CONFIG_BT_ID_MAX=3
CONFIG_BT_LONG_WQ=n
CONFIG_BT_BONDABLE=n
CONFIG_BT_GATT_SERVICE_CHANGED=n
CONFIG_BT_GATT_CACHING=n
CONFIG_BT_GATT_ENFORCE_SUBSCRIPTION=n
CONFIG_BT_GATT_READ_MULTIPLE=n
CONFIG_BT_DEVICE_NAME="Blecon"
CONFIG_BT_DIS=y
CONFIG_BT_DIS_PNP=n
CONFIG_BT_ECC=n

# Needs to be 1 + number of expected connections; See: https://devzone.nordicsemi.com/f/nordic-q-a/77588/advertising-failed-to-start-err--12/321268
CONFIG_BT_MAX_CONN=2

# Connection parameter update procedure
CONFIG_BT_CONN_PARAM_UPDATE_TIMEOUT=500

# DLE
CONFIG_BT_USER_DATA_LEN_UPDATE=y

# Needed to achieve MTU without fragmentation
CONFIG_BT_BUF_ACL_TX_COUNT=8
CONFIG_BT_BUF_ACL_TX_SIZE=251
CONFIG_BT_BUF_ACL_RX_SIZE=251
CONFIG_BT_L2CAP_TX_MTU=247

# Increase HCI RX stack size
CONFIG_BT_RX_STACK_SIZE=4096

# Bluetooth controller
# Uncomment to use the Zephyr link layer
# CONFIG_BT_LL_SW_SPLIT=y
CONFIG_BT_CTLR_CRYPTO=n
CONFIG_BT_CTLR_LE_ENC=n
CONFIG_BT_CTLR_ECDH=n
CONFIG_BT_CTLR_PHY_2M=n
CONFIG_BT_CTLR_PRIVACY=n
CONFIG_BT_LL_SOFTDEVICE_MULTIROLE=y
CONFIG_BT_CTLR_DATA_LENGTH_MAX=251

# NFC
#CONFIG_NFC_T2T_NRFXLIB=n
#CONFIG_NFC_NDEF_URI_MSG=n
#CONFIG_NFC_NDEF=y
#CONFIG_NFC_NDEF_MSG=y
#CONFIG_NFC_NDEF_RECORD=y
#CONFIG_NFC_NDEF_URI_REC=y

# Crypto
CONFIG_ENTROPY_GENERATOR=y

CONFIG_NRF_SECURITY=y
CONFIG_MBEDTLS_PSA_CRYPTO_C=y

CONFIG_MBEDTLS_ENABLE_HEAP=y
CONFIG_MBEDTLS_HEAP_SIZE=8192

# NVM
CONFIG_FLASH=y
CONFIG_FLASH_PAGE_LAYOUT=y

# Use PSA for flash integrity checks, not Mbed TLS
CONFIG_FLASH_AREA_CHECK_INTEGRITY_PSA=y
CONFIG_FLASH_AREA_CHECK_INTEGRITY_MBEDTLS=n

# Logging Output
CONFIG_LOG_BACKEND_RTT=y

# ADC
CONFIG_ADC_NRFX_SAADC=y
```

## boards/nrf52840dk_nrf52840.conf
```kconfig
# Copyright (c) Blecon Ltd
# SPDX-License-Identifier: Apache-2.0

# Select internal modem
CONFIG_BLECON_EXTERNAL_MODEM=n
CONFIG_BLECON_INTERNAL_MODEM=y
CONFIG_BLECON_INTERNAL_MODEM_NFC=y

# Internal modem platform
CONFIG_BLECON_PORT_CRYPTO=y
CONFIG_BLECON_PORT_NVM=y
CONFIG_BLECON_PORT_BLUETOOTH=y
CONFIG_BLECON_PORT_EVENT_LOOP=y
CONFIG_BLECON_PORT_NFC=y

# Bluetooth
CONFIG_BT=y
CONFIG_BT_OBSERVER=y
CONFIG_BT_PERIPHERAL=y
CONFIG_BT_USER_PHY_UPDATE=y

# At the moment, the following options are required to get L2CAP dynamic channels enabled
CONFIG_BT_SMP=y
# CONFIG_BT_CONN_DISABLE_SECURITY=y
CONFIG_BT_PRIVACY=n

CONFIG_BT_EXT_ADV=y
CONFIG_BT_L2CAP_DYNAMIC_CHANNEL=y
CONFIG_BT_L2CAP_SEG_RECV=y
CONFIG_BT_EXT_ADV_MAX_ADV_SET=3
CONFIG_BT_ID_MAX=3
CONFIG_BT_LONG_WQ=n
CONFIG_BT_BONDABLE=n
CONFIG_BT_GATT_SERVICE_CHANGED=n
CONFIG_BT_GATT_CACHING=n
CONFIG_BT_GATT_ENFORCE_SUBSCRIPTION=n
CONFIG_BT_GATT_READ_MULTIPLE=n
CONFIG_BT_DEVICE_NAME="Blecon"
CONFIG_BT_DIS=y
CONFIG_BT_DIS_PNP=n
CONFIG_BT_ECC=n

# Needs to be 1 + number of expected connections; See: https://devzone.nordicsemi.com/f/nordic-q-a/77588/advertising-failed-to-start-err--12/321268
CONFIG_BT_MAX_CONN=2

# Connection parameter update procedure
CONFIG_BT_CONN_PARAM_UPDATE_TIMEOUT=500

# DLE
CONFIG_BT_USER_DATA_LEN_UPDATE=y

# Needed to achieve MTU without fragmentation
CONFIG_BT_BUF_ACL_TX_COUNT=8
CONFIG_BT_BUF_ACL_TX_SIZE=251
CONFIG_BT_BUF_ACL_RX_SIZE=251
CONFIG_BT_L2CAP_TX_MTU=247

# Increase HCI RX stack size
CONFIG_BT_RX_STACK_SIZE=4096

# Bluetooth controller
# Uncomment to use the Zephyr link layer
# CONFIG_BT_LL_SW_SPLIT=y
CONFIG_BT_CTLR_CRYPTO=n
CONFIG_BT_CTLR_LE_ENC=n
CONFIG_BT_CTLR_ECDH=n
CONFIG_BT_CTLR_PHY_2M=n
CONFIG_BT_CTLR_PRIVACY=n
CONFIG_BT_LL_SOFTDEVICE_MULTIROLE=y
CONFIG_BT_CTLR_DATA_LENGTH_MAX=251

# NFC
CONFIG_NFC_T2T_NRFXLIB=y
CONFIG_NFC_NDEF_URI_MSG=y
CONFIG_NFC_NDEF=y
CONFIG_NFC_NDEF_MSG=y
CONFIG_NFC_NDEF_RECORD=y
CONFIG_NFC_NDEF_URI_REC=y

# Crypto
CONFIG_ENTROPY_GENERATOR=y

CONFIG_NRF_SECURITY=y
CONFIG_MBEDTLS_PSA_CRYPTO_C=y

CONFIG_MBEDTLS_ENABLE_HEAP=y
CONFIG_MBEDTLS_HEAP_SIZE=8192

# NVM
CONFIG_FLASH=y
CONFIG_FLASH_PAGE_LAYOUT=y

# Logging Output
CONFIG_LOG_BACKEND_UART=y

# QSPI for DFU storage
CONFIG_NORDIC_QSPI_NOR=y
CONFIG_NORDIC_QSPI_NOR_FLASH_LAYOUT_PAGE_SIZE=4096
```

## src/main.c
```c
// Copyright (c) Blecon Ltd
// SPDX-License-Identifier: Apache-2.0

#include <stdio.h>
#include <zephyr/kernel.h>
#include <zephyr/logging/log.h>
#include <blecon/blecon.h>
#include <zephyr/drivers/gpio.h>
#include <zephyr/drivers/led.h>
#include <zephyr/input/input.h>

#include <zephyr/drivers/flash.h>
#include <zephyr/storage/flash_map.h>
#include <zephyr/dfu/flash_img.h>
#include <zephyr/sys/reboot.h>

#include <memfault/metrics/metrics.h>
#include <memfault/components.h>

#include <blecon/blecon_buffer.h>

#include "ota/ota.h"
#include "blecon_zephyr/blecon_zephyr.h"
#include "blecon_zephyr/blecon_zephyr_event_loop.h"
#include "blecon_zephyr/blecon_zephyr_memfault.h"
#include "blecon/blecon_memfault_client.h"

#define MEMFAULT_REQUEST_NAMESPACE "memfault"

LOG_MODULE_REGISTER(main);

#define CONNECTION_PERIOD_SEC (15*60)
#define REBOOT_PERIOD_SEC 4500    // How frequently to reboot

#define FAST_BLINK_PERIOD_MS 200U
#define SLOW_BLINK_PERIOD_MS 500U
#define MAX_CONCURRENT_SEND_OPS 2

static struct blecon_t _blecon = {0};
static struct blecon_event_loop_t* _event_loop = NULL;

static struct blecon_event_t* _start_announce_event = NULL;
static struct blecon_event_t* _start_connect_event = NULL;

const static struct device *led_pwm;

// Function prototypes
static void update_metrics(void);

// Connection callbacks
static void on_connection(struct blecon_t* blecon);
static void on_disconnection(struct blecon_t* blecon);
static void on_time_update(struct blecon_t* blecon);
static void on_ping_result(struct blecon_t* blecon);

const static struct blecon_callbacks_t blecon_callbacks = {
    .on_connection = on_connection,
    .on_disconnection = on_disconnection,
    .on_time_update = on_time_update,
    .on_ping_result = on_ping_result,
};

// Input and timer callbacks
static void led_timeout(struct k_timer *timer);
static void input_cb(struct input_event *evt, void* user_data);
static void connect(struct k_timer *timer);
static void reboot(struct k_timer *timer);

K_TIMER_DEFINE(led_timer, led_timeout, NULL);
K_TIMER_DEFINE(connection_timer, connect, NULL);
K_TIMER_DEFINE(reboot_timer, reboot, NULL);

INPUT_CALLBACK_DEFINE(NULL, input_cb, NULL);

// Blecon activity triggers
static void on_announce_button(struct blecon_event_t* event, void* user_data);

void on_connection(struct blecon_t* blecon) {
    // Check for OTA update
    ota_check_request();

    // Disconnect 
    blecon_connection_terminate(&_blecon);
}

void on_disconnection(struct blecon_t* blecon) {
    LOG_DBG("%s", "Disconnected");
}

void on_time_update(struct blecon_t* blecon) {
   return;
}

void on_ping_result(struct blecon_t* blecon) {
    return;
}

void led_timeout(struct k_timer *timer) {
    int ret;
    ret = led_off(led_pwm, 0);
    if(ret < 0) {
        LOG_ERR("err=%d", ret);
        return;
    }
}

void connect(struct k_timer *timer) {
    blecon_event_signal(_start_connect_event);
}

void reboot(struct k_timer *timer) {
    sys_reboot(SYS_REBOOT_WARM);
}

void input_cb(struct input_event *evt, void* user_data)
{
    switch (evt->code) {
    case INPUT_KEY_0:
        if(evt->value == 1) {
            blecon_event_signal(_start_announce_event);
        }
        break;
    default:
        break;
    }
}

void on_announce_button(struct blecon_event_t* event, void* user_data) {
    int ret;

    ret = led_blink(led_pwm, 0, FAST_BLINK_PERIOD_MS/2U, FAST_BLINK_PERIOD_MS/2U);
    if(ret < 0) {
         LOG_ERR("blink error=%d", ret);
        return;
    }

    if(!blecon_announce(&_blecon)) {
        LOG_ERR("Error: %s", "announce");
        return;
    }

    k_timer_start(&led_timer, K_SECONDS(5), K_FOREVER);
}

void on_start_connect(struct blecon_event_t* event, void* user_data) {
    LOG_DBG("%s", "Starting connection");
    if(!blecon_connection_initiate(&_blecon)) {
        LOG_ERR("Error: %s", "could not initiate connection.");
    }
}

int main(void)
{
    k_timer_start(&reboot_timer, K_SECONDS(REBOOT_PERIOD_SEC), K_FOREVER);

    led_pwm = DEVICE_DT_GET(DT_PATH(pwmleds));
    if (!device_is_ready(led_pwm)) {
        LOG_ERR("Device %s is not ready\n", led_pwm->name);
        return 0;
    }

    // Get event loop
    _event_loop = blecon_zephyr_get_event_loop();

    // Get modem
    struct blecon_modem_t* modem = blecon_zephyr_get_modem();

    // Register events that need to be run on the Blecon thread
    _start_announce_event = blecon_event_loop_register_event(_event_loop, on_announce_button, NULL);
    _start_connect_event = blecon_event_loop_register_event(_event_loop, on_start_connect, NULL);

    // Init Blecon
    blecon_init(&_blecon, modem);
    blecon_set_callbacks(&_blecon, &blecon_callbacks, NULL);
    if(!blecon_setup(&_blecon)) {
        return 1;
    }

    // Init Memfault
    struct blecon_memfault_t* memfault = blecon_zephyr_memfault_init();

    struct blecon_memfault_client_t memfault_client;
    
    uint8_t blecon_id[BLECON_UUID_SZ] = {0};
    if(!blecon_get_identity(&_blecon, blecon_id)) {
        printk("Failed to get identity\r\n");
        return 1;
    }
    
    blecon_memfault_client_init(&memfault_client, blecon_get_request_processor(&_blecon), memfault, blecon_id, MEMFAULT_REQUEST_NAMESPACE);

    // Init OTA module
    ota_init(_event_loop, &_blecon, MEMFAULT_REQUEST_NAMESPACE);

    // Print device URL
    char blecon_url[BLECON_URL_SZ] = {0};
    if(!blecon_get_url(&_blecon, blecon_url, sizeof(blecon_url))) {
        printk("Failed to get device URL\r\n");
        return 1;
    }
    LOG_INF("Device URL: %s", blecon_url);

    // Start connection timer
    k_timer_start(&connection_timer, K_SECONDS(CONNECTION_PERIOD_SEC), K_SECONDS(CONNECTION_PERIOD_SEC));

    // Initiate connection
    blecon_connection_initiate(&_blecon);

    blecon_event_loop_run(_event_loop);
    // won't ever reach here
    return 0;
}

// Handle memfault metric heartbeat timer
// This overrides a weak definition
void memfault_metrics_heartbeat_collect_data(void) {
    // Metrics are committed and reset per heartbeat, populating them here ensures at least one point per heartbeat
    update_metrics();
}

void update_metrics(void) {
    MEMFAULT_METRIC_SET_UNSIGNED(buffers_allocation_count, blecon_buffer_total_allocations_count());
    MEMFAULT_METRIC_SET_UNSIGNED(buffers_allocation_size, blecon_buffer_total_allocations_size());
}
```
