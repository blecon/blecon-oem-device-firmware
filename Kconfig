## Kconfig
```kconfig
# Copyright (c) Blecon Ltd
# SPDX-License-Identifier: Apache-2.0

# Workaround for not being able to have commas in macro arguments
DT_CHOSEN_BLECON_LED_STATUS := blecon,led-status
DT_CHOSEN_BLECON_SW_POWER := blecon,sw-power

config BLECON_LIB_BATTERY
    bool "Battery driver"
    default n
config BLECON_LIB_OTA
    bool "OTA module"
    default n
config BLECON_LIB_MOTION
    bool "Motion module"
    default n
config BLECON_LIB_LED
    bool "Status LED module"
    default y if $(dt_chosen_enabled,$(DT_CHOSEN_BLECON_LED_STATUS))
config BLECON_LIB_POWER_SW
    select PM_DEVICE
    select PM_DEVICE_RUNTIME
    select POWEROFF
    select HWINFO
    bool "Power switch module"
    default y if $(dt_chosen_enabled,$(DT_CHOSEN_BLECON_SW_POWER))
config BLECON_APP_VERSION
    string "Blecon App version (semver)"
    default "0.0.0"
config BLECON_APP_BUILD_NUMBER
    int "Blecon App build number"
    default 0
config MEMFAULT_DEMO_GESTURE_DETECT
    bool "Implement gesture detect handler (so that demo doesn't crash)"
    default 0
```

## apps/minimal-app/Kconfig
```kconfig
# Copyright (c) Blecon Ltd
# SPDX-License-Identifier: Apache-2.0

menu "Zephyr Kernel"
source "Kconfig.zephyr"
endmenu
```

## apps/minimal/sysbuild/mcuboot/boards/k7p54l_nrf54l15_cpuapp.conf
```kconfig
# Copyright (c) Blecon Ltd
# SPDX-License-Identifier: Apache-2.0

CONFIG_MULTITHREADING=y
CONFIG_FLASH=y

CONFIG_BT=n

CONFIG_PM_PARTITION_SIZE_MCUBOOT=0xD000
CONFIG_MAIN_STACK_SIZE=20480

CONFIG_BOOT_MAX_IMG_SECTORS=256

# TODO: below are not yet supported and need fixing
CONFIG_FPROTECT=n

# Ensure that the SPI NOR driver is disabled by default
CONFIG_SPI_NOR=n

CONFIG_BOOT_WATCHDOG_FEED=n
```

## apps/minimal/sysbuild/mcuboot/boards/kkm_s5_bcn.conf
```kconfig
# Copyright (c) Blecon Ltd
# SPDX-License-Identifier: Apache-2.0

CONFIG_PM_OVERRIDE_EXTERNAL_DRIVER_CHECK=y
CONFIG_SPI_NOR_FLASH_LAYOUT_PAGE_SIZE=4096
CONFIG_SPI_NRFX_RAM_BUFFER_SIZE=32
```

## apps/proximity-spotter/Kconfig
```kconfig
# Copyright (c) Blecon Ltd
# SPDX-License-Identifier: Apache-2.0

menu  "Blecon Proximity Spotter"
DT_CHOSEN_BLECON_LED_PROXIMITY := blecon,led-proximity
config LED_PROXIMITY
    bool "Modulate LED brigtness based on closest neighbour"
    default y if $(dt_chosen_enabled,$(DT_CHOSEN_BLECON_LED_PROXIMITY))
config PROXIMITY_RSSI_THRESHOLD
    int "Minimum RSSI threshold to log scanned device"
    default -45
config PROXIMITY_RSSI_MIN_BRIGHTNESS
    depends on LED_PROXIMITY
    int "RSSI corresponding to minimum brightness"
    default PROXIMITY_RSSI_THRESHOLD
config PROXIMITY_RSSI_MAX_BRIGHTNESS
    depends on LED_PROXIMITY
    int "RSSI corresponding to maximum brightness"
    default -20
endmenu

menu "Zephyr Kernel"
source "Kconfig.zephyr"
endmenu
```

## apps/sensor-ml/Kconfig
```kconfig
# Copyright (c) Blecon Ltd
# SPDX-License-Identifier: Apache-2.0

menu  "Blecon Sensor (ML)"
DT_CHOSEN_BLECON_LED_GESTURE_1 := blecon,led-gesture-1
DT_CHOSEN_BLECON_LED_GESTURE_2 := blecon,led-gesture-2
config LED_GESTURE
    bool "Enable LED pattern on gesture detection"
    default y if $(dt_chosen_enabled,$(DT_CHOSEN_BLECON_LED_GESTURE_1)) && $(dt_chosen_enabled,$(DT_CHOSEN_BLECON_LED_GESTURE_2))
config REPORTING_PERIOD_SEC
    int "Reporting period (seconds)"
    default 300
config LEDS_ENABLED_DURATION_MIN
    int "How long should LEDs be enabled for after button press (minutes)"
    default 720
endmenu

menu "Zephyr Kernel"
source "Kconfig.zephyr"
endmenu
```

## boards/mokosmart/mkbnl02sn/board.yml
```yaml
# Copyright (c) Blecon Ltd
# SPDX-License-Identifier: Apache-2.0
board:
  name: mkbnl02sn
  vendor: mokosmart
  socs:
  - name: nrf54l15
    variants:
    - name: xip
      cpucluster: cpuflpr
    - name: ns
      cpucluster: cpuapp
```

## west.yml
```yaml
# Copyright (c) Blecon Ltd
# SPDX-License-Identifier: Apache-2.0
manifest:
  projects:
    - name: nrf
      revision: v2.8.0
      url: http://github.com/nrfconnect/sdk-nrf
      import:
        path-blocklist:
          - nrf/modules/memfault-firmware-sdk/*
    - name: zephyr
      revision: v3.7.99-ncs1
      url: https://github.com/nrfconnect/sdk-zephyr
      import:
        name-allowlist:
          - TraceRecorderSource
          - canopennode
          - chre
          - cmsis
          - cmsis-dsp
          - cmsis-nn
          - edtt
          - fatfs
          - hal_nordic
          - hal_st # required for ST sensors (unrelated to STM32 MCUs)
          - hal_wurthelektronik
          - liblc3
          - libmetal
          - littlefs
          - loramac-node
          - lvgl
          - lz4
          - mipi-sys-t
          - nanopb
          - net-tools
          - nrf_hw_models
          - open-amp
          - picolibc
          - segger
          - tinycrypt
          - tf-m-tests
          - uoscore-uedhoc
          - zcbor
          - zscilib
    - name: blecon-device-sdk
      revision: fef8aba3d6f87bd613e0255030d8242380299919
      url: https://github.com/blecon/blecon-device-sdk
    - name: memfault-firmware-sdk
      revision: 1.12.0
      path: modules/lib/memfault-firmware-sdk
      url: https://github.com/memfault/memfault-firmware-sdk
  self:
    path: blecon-oem-device-firmware
```
